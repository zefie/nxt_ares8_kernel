## drivers/external_drivers/drivers/input/Kconfig
```kconfig
source "drivers/external_drivers/drivers/input/touchscreen/Kconfig"
source "drivers/external_drivers/drivers/input/sensors/Kconfig"
source "drivers/external_drivers/drivers/input/misc/Kconfig"
```

## drivers/iio/imu/st_lsm6ds3/Kconfig
```kconfig
#
# st-lsm6ds3 drivers for STMicroelectronics combo sensor
#

config ST_LSM6DS3_IIO
	tristate "STMicroelectronics LSM6DS3 sensor"
	depends on (I2C || SPI) && SYSFS
	select IIO_BUFFER
	select IIO_TRIGGERED_BUFFER
	help
	  This driver supports the STMicroelectronics LSM6DS3 sensor.
	  It is a gyroscope/accelerometer combo device.
	  This driver can be built as a module. The module will be called
	  st-lsm6ds3.

config ST_LSM6DS3_SELFTEST
	bool "ST LSM6DS3 self-test support"
	depends on ST_LSM6DS3_IIO
	default n
	help
	  If you say yes here to enable LSM6DS3 self-test interface.

config ST_LSM6DS3_CAL_SUPPORT
	bool "ST LSM6DS3 calibrate support"
	depends on ST_LSM6DS3_IIO
	default n
	help
	  If you say yes here to enable LSM6DS3 calibrate interface.

config ST_LSM6DS3_IIO_SENSORS_WAKEUP
	bool "All sensors can wake-up system during suspend"
	depends on ST_LSM6DS3_IIO
	default n
	help
	  If disabled only tilt and significant motion can wake-up system
	  during suspend.
	  If enabled all sensors can wake-up system during suspend.

menuconfig ST_LSM6DS3_IIO_MASTER_SUPPORT
	bool "I2C master controller"
	depends on I2C && ST_LSM6DS3_IIO
	default n
	help
	  Added support for I2C master controller. Supported sensors up
	  to 4.

if ST_LSM6DS3_IIO_MASTER_SUPPORT

config ST_LSM6DS3_ENABLE_INTERNAL_PULLUP
	bool "Enabled internals pull-up resistors"
	default y

choice
	prompt "External sensor 0"
	default ST_LSM6DS3_IIO_EXT0_LIS3MDL
	help
	  Choose the external sensor 0 connected to LSM6DS3.

config ST_LSM6DS3_IIO_EXT0_LIS3MDL
	bool "LIS3MDL"
config ST_LSM6DS3_IIO_EXT0_AKM09912
	bool "AKM09912"
endchoice

choice
	prompt "External sensor 1"
	default ST_LSM6DS3_IIO_EXT1_DISABLED
	help
	  Choose the external sensor 1 connected to LSM6DS3.

config ST_LSM6DS3_IIO_EXT1_DISABLED
	bool "Disabled"
config ST_LSM6DS3_IIO_EXT1_LPS22HB
	bool "LPS22HB"
endchoice

endif
```
